#include <inttypes.h>
#include <stdbool.h>
#include <stddef.h>
#include <stdint.h>
#include <string.h>

#include <zephyr/logging/log.h>

#include "fsl_sss_se05x_types.h"
#include "se05x_APDU.h"
#include "se05x_APDU_apis.h"
#include "se05x_demo.h"

LOG_MODULE_REGISTER(se05x_demo_cert, LOG_LEVEL_INF);

/*
 * 07 号业务 demo：CERTIFICATE_STORE，设备证书对象写入和回读校验。
 *
 * 真实业务含义：
 *   量产 provisioning 工站通常会在 SE05x 中保存设备证书、证书链或业务公钥
 *   材料。TLS 客户端认证时，应用从 SE05x 读取证书发给服务器，而私钥仍在
 *   SE05x 内部完成签名。
 *
 * 当前 demo 的边界：
 *   - 会写 SE05x persistent NVM。
 *   - 写入对象：SE05X_DEMO_OBJECT_ID_CERT，也就是 0xEF070001。
 *   - 写入内容：和 06 号 demo 私钥匹配的自签 DER demo 证书，只用于开发验证。
 *   - 如果对象已经存在，本 demo 不覆盖，只回读并和 demo 证书做比较。
 *   - 如果已有对象内容不同，demo 会 FAIL，提醒不要误覆盖未知对象。
 *
 * 执行流程：
 *   1. CheckObjectExists(0xEF070001)：确认 demo 证书对象是否已存在。
 *   2. 不存在时：allocate persistent binary object，并写入 DER demo 证书。
 *   3. 存在时：sss_key_object_get_handle() 获取已有对象，绝不覆盖。
 *   4. sss_key_store_get_key() 回读证书。
 *   5. 对比长度和内容，确认写入/已有对象就是本 demo 期望的证书。
 *
 * 期望串口输出：
 *   - 能看到 cert object_id=0xEF070001。
 *   - 首次运行看到 created=yes；再次运行看到 created=no。
 *   - 能看到 certificate preview 和 cert_len=408。
 *   - 最后应看到 “CERTIFICATE_STORE 汇总：... fail=0”。
 */

static const uint8_t k_demo_device_cert_der[] = {
	0x30, 0x82, 0x01, 0x94, 0x30, 0x82, 0x01, 0x3A, 0xA0, 0x03, 0x02, 0x01,
	0x02, 0x02, 0x06, 0x54, 0x05, 0x20, 0x06, 0x07, 0x08, 0x30, 0x0A, 0x06,
	0x08, 0x2A, 0x86, 0x48, 0xCE, 0x3D, 0x04, 0x03, 0x02, 0x30, 0x48, 0x31,
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	0xCD, 0xEC, 0x2D, 0xA2, 0x5D, 0xEB, 0x52, 0xE2, 0x32, 0x90, 0x97, 0xF8
};

static smStatus_t check_object_exists(pSe05xSession_t session, uint32_t object_id, bool *exists)
{
	SE05x_Result_t result = kSE05x_Result_NA;
	smStatus_t sw = Se05x_API_CheckObjectExists(session, object_id, &result);

	if (sw == SM_OK) {
		*exists = (result == kSE05x_Result_SUCCESS);
	}

	return sw;
}

static void prepare_certificate_object(se05x_demo_stats_t *stats, ex_sss_boot_ctx_t *boot_ctx,
				       pSe05xSession_t se_session, sss_object_t *cert_obj)
{
	bool exists = false;
	smStatus_t sw = check_object_exists(se_session, SE05X_DEMO_OBJECT_ID_CERT, &exists);
	sss_status_t status;

	if (sw != SM_OK) {
		se05x_demo_mark_fail_sw(stats, "CheckObjectExists(DEMO_CERT)", sw);
		return;
	}

	LOG_INF("Certificate object_id=0x%08" PRIX32 " exists=%s",
		(uint32_t)SE05X_DEMO_OBJECT_ID_CERT, exists ? "yes" : "no");

	status = sss_key_object_init(cert_obj, &boot_ctx->ks);
	if (status != kStatus_SSS_Success) {
		se05x_demo_mark_fail_status(stats, "sss_key_object_init(DEMO_CERT)", status);
		return;
	}

	if (exists) {
		status = sss_key_object_get_handle(cert_obj, SE05X_DEMO_OBJECT_ID_CERT);
		if (status == kStatus_SSS_Success) {
			se05x_demo_mark_pass(stats, "GetHandle(DEMO_CERT)");
		} else {
			se05x_demo_mark_fail_status(stats, "GetHandle(DEMO_CERT)", status);
		}
		return;
	}

	status = sss_key_object_allocate_handle(cert_obj, SE05X_DEMO_OBJECT_ID_CERT,
					       kSSS_KeyPart_Default,
					       kSSS_CipherType_Binary,
					       sizeof(k_demo_device_cert_der),
					       kKeyObject_Mode_Persistent);
	if (status != kStatus_SSS_Success) {
		se05x_demo_mark_fail_status(stats, "AllocateHandle(DEMO_CERT)", status);
		return;
	}

	status = sss_key_store_set_key(&boot_ctx->ks, cert_obj, k_demo_device_cert_der,
				       sizeof(k_demo_device_cert_der),
				       sizeof(k_demo_device_cert_der) * 8U, NULL, 0);
	if (status == kStatus_SSS_Success) {
		LOG_INF("Certificate persistent object created=yes object_id=0x%08" PRIX32,
			(uint32_t)SE05X_DEMO_OBJECT_ID_CERT);
		se05x_demo_mark_pass(stats, "SetKey(DEMO_CERT)");
	} else {
		se05x_demo_mark_fail_status(stats, "SetKey(DEMO_CERT)", status);
	}
}

static void read_and_verify_certificate(se05x_demo_stats_t *stats,
					ex_sss_boot_ctx_t *boot_ctx,
					sss_object_t *cert_obj)
{
	uint8_t cert[512] = { 0 };
	size_t cert_len = sizeof(cert);
	size_t cert_bit_len = 0;
	sss_status_t status = sss_key_store_get_key(&boot_ctx->ks, cert_obj, cert,
						    &cert_len, &cert_bit_len);

	if (status != kStatus_SSS_Success) {
		se05x_demo_mark_fail_status(stats, "GetKey(DEMO_CERT)", status);
		return;
	}

	LOG_INF("Certificate readback len=%u bit_len=%u", (unsigned int)cert_len,
		(unsigned int)cert_bit_len);
	se05x_demo_log_hex_preview("CertificateDER", cert, cert_len);

	if (cert_len != sizeof(k_demo_device_cert_der) ||
	    memcmp(cert, k_demo_device_cert_der, sizeof(k_demo_device_cert_der)) != 0) {
		LOG_ERR("Certificate object exists but content is not this demo certificate");
		se05x_demo_mark_fail_status(stats, "Compare(DEMO_CERT)", kStatus_SSS_Fail);
		return;
	}

	se05x_demo_mark_pass(stats, "GetKey+Compare(DEMO_CERT)");
}

static sss_status_t run_certificate_store(ex_sss_boot_ctx_t *boot_ctx)
{
	se05x_demo_stats_t stats;
	sss_se05x_session_t *session = (sss_se05x_session_t *)&boot_ctx->session;
	pSe05xSession_t se_session = &session->s_ctx;
	sss_object_t cert_obj = { 0 };

	se05x_demo_stats_init(&stats, "CERTIFICATE_STORE");
	LOG_INF("CERTIFICATE_STORE 开始：写入/复用 demo 设备证书并回读校验");
	LOG_INF("会写 persistent NVM：object_id=0x%08" PRIX32
		"；已有对象时不覆盖",
		(uint32_t)SE05X_DEMO_OBJECT_ID_CERT);

	prepare_certificate_object(&stats, boot_ctx, se_session, &cert_obj);
	if (stats.fail == 0U) {
		read_and_verify_certificate(&stats, boot_ctx, &cert_obj);
	}

	sss_key_object_free(&cert_obj);
	se05x_demo_log_summary(&stats);
	return se05x_demo_stats_result(&stats);
}

const se05x_demo_t g_se05x_demo_certificate_store = {
	.id = SE05X_DEMO_CERTIFICATE_STORE,
	.name = "certificate_store",
	.when_to_use = "需要验证设备证书、证书链或业务公钥材料能写入 SE05x 并可回读时使用。",
	.flow = "检查 demo certificate object，必要时写入 persistent DER 证书，然后回读并逐字节校验。",
	.expected_output = "看到 cert object_id、created/reused 状态、证书长度和 preview，最终 fail=0。",
	.se_features = "SSS binary object、persistent certificate storage、object exists、get/set key。",
	.run = run_certificate_store,
};
